## config/boards/shields/aonami/Kconfig.shield
```kconfig
config SHIELD_AONAMI_LEFT
    def_bool $(shields_list_contains,aonami_left)

config SHIELD_AONAMI_RIGHT
    def_bool $(shields_list_contains,aonami_right)
```

## config/west.yml
```yaml
manifest:
  remotes:
    - name: zmkfirmware
      url-base: https://github.com/zmkfirmware
  projects:
    - name: zmk
      remote: zmkfirmware
      revision: main
      import: app/west.yml
    - name: zmk-config-aonami
      url: https://github.com/seenbytony/zmk-config-aonami
      revision: main
      path: modules/zmk-config-aonami
  self:
    path: config
```
